## firmware/main/Kconfig.projbuild
```kconfig
menu "Warnemuende Lighthouse"
    config WLED_DIN_PIN
        int "WLED Data In Pin"
        default 8
        help
            The number of the WLED data in pin.

    config WLED_USE_DMA
        bool "Use DMA for WLED"
        default n
        help
            Use DMA to drive the WLED strip. This is more efficient and allows for smoother animations.

    config WLED_DMA_USAGE
        int
        default 1 if WLED_USE_DMA
        default 0 if !WLED_USE_DMA

    config WLED_WITH_WHITE
        bool "WLED with White Channel"
        default y
        help
            Use a WLED strip with a white channel (e.g. WS2812B RGBW).

    config LED_PIN_LEFT
        int "LED Left Pin"
        default 11
        help
            The pin of the LED for the left side.

    config LED_PIN_RIGHT
        int "LED Right Pin"
        default 12
        help
            The pin of the LED for the right side.

    config BONDING_PASSPHRASE
        int "Bonding Passphrase"
        default 123456
        help
            The passphrase for the BLE bonding.

endmenu
```

## main/Kconfig.projbuild
```kconfig
menu "Warnemuende Lighthouse"
    config WLED_DIN_PIN
        int "WLED Data In Pin"
        default 14
        help
            The number of the WLED data in pin.

    choice LIGHT_CHARACTERISTIC_CHOICE
        prompt "Light characteristic"
        default LIGHT_CHARACTERISTIC_GREEN
        help
            The color of the main WLED light.

        config LIGHT_CHARACTERISTIC_GREEN
            bool "Green flashing light"
            help
                The light will be flashing green.

        config LIGHT_CHARACTERISTIC_RED
            bool "Red flashing light"
            help
                The light will be flashing red.
    endchoice

    config LIGHT_CHARACTERISTIC_VALUE
        int
        default 1 if LIGHT_CHARACTERISTIC_GREEN
        default 2 if LIGHT_CHARACTERISTIC_RED
endmenu
```
